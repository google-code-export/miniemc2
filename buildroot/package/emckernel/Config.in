## buildroot/package/emckernel/Config.in
```kconfig
config BR2_PACKAGE_EMC2_KERNEL
	bool "KERNEL for EMC2 CNC controller"
	select BR2_PACKAGE_EMC2_UBOOT
	help
	  Linux kernel for miniemc2
```

## buildroot/package/modminiemc/Config.in
```kconfig
config BR2_PACKAGE_EMC2_MODMINIEMC
	bool "EMC2 CNC controller kernel module"
	depends on BR2_PACKAGE_EMC2_KERNEL
	help
	  EMC2 for SAMSUNG's S3C24xx CPU: kernel helper module
```

## buildroot/target/device/miniemc2/Config.in
```kconfig
menuconfig BR2_TARGET_MINIEMC2
       bool "miniemc2 CNC controller"

if BR2_TARGET_MINIEMC2

config BR2_TARGET_MINIEMC2_MINI2440
    bool "Support for miniEMC2 project on mini2440 board"
    help 
	This option enables support for Company project Foobar

config BR2_TARGET_MINIEMC2_MINI2416
    bool "Support for miniEMC2 project on mini2416 board"
    help 
	This option enables support for Company project Foobar
endif
```

## kernel/linux-2.6.35.9/kernel/ipipe/Kconfig
```kconfig
config IPIPE
	bool "Interrupt pipeline"
	default y
	---help---
	  Activate this option if you want the interrupt pipeline to be
	  compiled in.

config IPIPE_DOMAINS
	int "Max domains"
	depends on IPIPE
	default 4
	---help---
	The maximum number of I-pipe domains to run concurrently.

config IPIPE_DELAYED_ATOMICSW
       bool
       depends on IPIPE
       default n

config IPIPE_UNMASKED_CONTEXT_SWITCH
       bool
       depends on IPIPE
       default n

config HAVE_IPIPE_HOSTRT
       bool
```

## tags/v08rc1/buildroot/package/qt2/Config.in
```kconfig
config BR2_PACKAGE_QT2
	bool "QT-2.3.10 library"
	depends on BR2_INSTALL_LIBSTDCPP
	help
	    If unsure - unselect
```

## tags/v08rc1/buildroot/package/uboot/Config.in
```kconfig
config BR2_PACKAGE_EMC2_UBOOT
	bool "UBOOT for EMC2 CNC controller"
	help
	  Bootloader for miniemc2
```

## trunk/buildroot/package/boost/Config.in
```kconfig
config BR2_PACKAGE_BOOST
	depends on BR2_PACKAGE_BUSYBOX
	bool "Boost C++ library"
	help
	    If unsure - unselect
if BR2_PACKAGE_BOOST
config BR2_BOOST_TEST
	bool "Boost test unit support"

config BR2_BOOST_MATH
	bool "Boost math functions support"

config BR2_BOOST_SYSTEM
	bool "Boost system support"

config BR2_BOOST_FILESYSTEM
	bool "Boost filesystem support"

config BR2_BOOST_SERIALIZATION
	bool "Boost serialization support"

endif
```

## trunk/buildroot/package/emc2/Config.in
```kconfig
config BR2_PACKAGE_EMC2
	bool "EMC2 CNC controller"
	select BR2_PACKAGE_XENOMAI
	select BR2_PACKAGE_EMC2_KERNEL
	select BR2_PACKAGE_EMC2_MODMINIEMC
	help
	  EMC2 for SAMSUNG's S3C24xx CPU
```

## trunk/buildroot/package/emcweb/Config.in
```kconfig
config BR2_PACKAGE_EMC2_EMCWEB
	bool "EMC2 CNC controller's WEB interface"
	select BR2_PACKAGE_EMC2
	select BR2_PACKAGE_BOOST
	select BR2_BOOST_SYSTEM
	select BR2_BOOST_SERIALIZATION
	help
	  EMC2 WEB interface for SAMSUNG's S3C24xx CPU
```
